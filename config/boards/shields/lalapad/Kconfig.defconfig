## config/boards/shields/lalapad/Kconfig.defconfig
```kconfig
if SHIELD_LALAPAD_RIGHT

config ZMK_KEYBOARD_NAME
    default "Lalapad"

config ZMK_SPLIT_ROLE_CENTRAL
    default y

endif

if SHIELD_LALAPAD_LEFT || SHIELD_LALAPAD_RIGHT

config ZMK_SPLIT
    default y

endif
```
